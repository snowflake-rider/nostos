## esp-ble-unorganized/examples/esp32c3/generic-onoff-node/sdkconfig.defaults
```kconfig
# Bluetooth와 ESP-BLE-MESH 활성화
CONFIG_BT_ENABLED=y
CONFIG_BT_GATTS_SEND_SERVICE_CHANGE_MANUAL=y
CONFIG_BT_BTU_TASK_STACK_SIZE=4512

# ESP-BLE-MESH 예제는 Legacy Advertising 동작을 기준으로 시작한다.
CONFIG_BT_BLE_50_FEATURES_SUPPORTED=n
CONFIG_BT_BLE_42_FEATURES_SUPPORTED=y

CONFIG_PARTITION_TABLE_SINGLE_APP_LARGE=y

CONFIG_BLE_MESH=y
CONFIG_BLE_MESH_NODE=y
CONFIG_BLE_MESH_PB_ADV=y
CONFIG_BLE_MESH_PB_GATT=y
CONFIG_BLE_MESH_RELAY=y
CONFIG_BLE_MESH_SETTINGS=y
CONFIG_BLE_MESH_TX_SEG_MSG_COUNT=10
CONFIG_BLE_MESH_RX_SEG_MSG_COUNT=10
CONFIG_BLE_MESH_GENERIC_SERVER=y
```

## firmware/esp32/main/Kconfig.projbuild
```kconfig
menu "NOSTOS message protocol"
config NOSTOS_SOURCE1_ADDRESS
    hex "Provisioned Mesh primary for source1"
    range 0x0 0x7fff
    default 0x0003
config NOSTOS_SOURCE2_ADDRESS
    hex "Provisioned Mesh primary for source2"
    range 0x0 0x7fff
    default 0x0005
config NOSTOS_SOURCE3_ADDRESS
    hex "Provisioned Mesh primary for source3"
    range 0x0 0x7fff
    default 0x0006
config NOSTOS_SOURCE4_ADDRESS
    hex "Provisioned Mesh primary for source4 (optional)"
    range 0x0 0x7fff
    default 0x0000
config NOSTOS_SOURCE5_ADDRESS
    hex "Provisioned Mesh primary for source5 (optional)"
    range 0x0 0x7fff
    default 0x0000
config NOSTOS_SOURCE6_ADDRESS
    hex "Provisioned Mesh primary for source6 (optional)"
    range 0x0 0x7fff
    default 0x0000
config NOSTOS_SOURCE7_ADDRESS
    hex "Provisioned Mesh primary for source7 (optional)"
    range 0x0 0x7fff
    default 0x0000
config NOSTOS_SOURCE8_ADDRESS
    hex "Provisioned Mesh primary for source8 (optional)"
    range 0x0 0x7fff
    default 0x0000
config NOSTOS_SOURCE9_ADDRESS
    hex "Provisioned Mesh primary for source9 (optional)"
    range 0x0 0x7fff
    default 0x0000
config NOSTOS_SOURCE10_ADDRESS
    hex "Provisioned Mesh primary for source10 (optional)"
    range 0x0 0x7fff
    default 0x0000
config NOSTOS_RIDE_PUBLISHER_SOURCE
    int "Active RIDE publisher source node"
    range 1 10
    default 1
config NOSTOS_ENVIRONMENT_PUBLISHER_SOURCE
    int "Active ENVIRONMENT publisher source node"
    range 1 10
    default 2
config NOSTOS_XOSS_SPEED_SENSOR
    bool "Enable XOSS CSC speed-sensor GATT client"
    default y
    depends on BT_GATTC_ENABLE
config NOSTOS_XOSS_DEVICE_NAME
    string "Exact BLE advertising name for the XOSS sensor"
    default "XOSS S-26518"
    depends on NOSTOS_XOSS_SPEED_SENSOR
config NOSTOS_XOSS_WHEEL_CIRCUMFERENCE_MM
    int "Measured wheel circumference in millimetres"
    range 1 10000
    default 2100
    depends on NOSTOS_XOSS_SPEED_SENSOR
config NOSTOS_XOSS_STALE_MS
    int "Speed sample stale timeout in milliseconds"
    range 1000 30000
    default 3000
    depends on NOSTOS_XOSS_SPEED_SENSOR
endmenu
```

## firmware/v1/esp32/main/Kconfig.projbuild
```kconfig
menu "NOSTOS message protocol"
config NOSTOS_PROTOCOL_V2
    bool "Use framed v2 protocol (all connected STM32/ESP32 must use v2)"
    default n
config NOSTOS_LOCAL_SOURCE
    int "Local rider/source (1..3)"
    range 1 3
    default 1
    depends on NOSTOS_PROTOCOL_V2
config NOSTOS_SOURCE1_ADDRESS
    hex "Provisioned Mesh address for source1 (0 disables startup)"
    range 0x0 0x7fff
    default 0x0
    depends on NOSTOS_PROTOCOL_V2
config NOSTOS_SOURCE2_ADDRESS
    hex "Provisioned Mesh address for source2 (0 disables startup)"
    range 0x0 0x7fff
    default 0x0
    depends on NOSTOS_PROTOCOL_V2
config NOSTOS_SOURCE3_ADDRESS
    hex "Provisioned Mesh address for source3 (0 disables startup)"
    range 0x0 0x7fff
    default 0x0
    depends on NOSTOS_PROTOCOL_V2
endmenu
```
